&pointing_listener {
    status = "okay";
    device = <&pointing_device>;
    input-processors = <
            &zip_temp_layer 4 1000
        >;
    input-processors = <
            &zip_xy_transform (INPUT_TRANSFORM_X_INVERT | INPUT_TRANSFORM_Y_INVERT)
        >;
    scroller {
        layers = <5>;
        input-processors = <&zip_xy_to_scroll_mapper>;
    };
};
